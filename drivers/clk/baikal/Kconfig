## drivers/clk/baikal/Kconfig
```kconfig
# SPDX-License-Identifier: GPL-2.0

config CLK_BL1000
	bool "Baikal BE-L1000 SoC clock driver"
	depends on ARCH_BAIKAL || COMPILE_TEST
	default ARCH_BAIKAL
	help
	  Enable Baikal BE-L1000 CMU clock driver.

config CLK_BM1000
	bool "Baikal BE-M1000 SoC clock driver"
	depends on ARCH_BAIKAL || COMPILE_TEST
	default ARCH_BAIKAL
	help
	  Enable Baikal BE-M1000 CMU clock driver.

config CLK_BS1000
	bool "Baikal BE-S1000 SoC clock driver"
	depends on ARCH_BAIKAL || COMPILE_TEST
	default ARCH_BAIKAL
	help
	  Enable Baikal BE-S1000 CMU clock driver.
```

## drivers/phy/baikal/Kconfig
```kconfig
# SPDX-License-Identifier: GPL-2.0-only

config USB_PHY_BAIKAL
	tristate "Baikal USB PHY driver"
	depends on USB_SUPPORT
	select GENERIC_PHY
	select USB_PHY
	help
	  Enable this to support the USB PHY on Baikal SoCs.
	  This driver controls both the USB2 PHY and the USB3 PHY.

config DP_PHY_BAIKAL
	tristate "Baikal DisplayPort PHY driver"
	depends on OF
	depends on HAS_IOMEM
	depends on COMMON_CLK
	select GENERIC_PHY
	help
	  Support for Baikal DP PHY.
```

## drivers/pmdomain/baikal/Kconfig
```kconfig
# SPDX-License-Identifier: GPL-2.0-only
config BAIKAL_PD_SMC
	tristate "Baikal SoC's SMC power domains driver"
	depends on ARCH_BAIKAL || (COMPILE_TEST && OF)
	depends on HAVE_ARM_SMCCC
	default y
	select PM_GENERIC_DOMAINS if PM
	help
	  This enables Baikal SoC's (BE-L1000 only now) power domains control
	  driver.

	  This driver can also be built as a module. If so, the module
	  will be called baikal_pd_smc.
```

## drivers/reset/baikal/Kconfig
```kconfig
# SPDX-License-Identifier: GPL-2.0-only
config RESET_BL1000
	tristate "Baikal BE-L1000 Reset Driver"
	help
	  This enables the reset driver for Baikal Electronics BE-L1000 SoCs.
```
